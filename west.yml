## west.yml
```yaml
manifest:
  version: 0.7

  self:
    west-commands: scripts/west-commands.yml

  remotes:
    - name: zephyrproject-rtos
      url-base: https://github.com/zephyrproject-rtos
    - name: borrelunde
      url-base: https://github.com/borrelunde

  projects:
    - name: zephyr
      remote: zephyrproject-rtos
      revision: main
      import:
        # By using name-allowlist we can clone only the modules that are
        # strictly needed by the application.
        name-allowlist:
          - cmsis # required by the ARM port
          - hal_nordic # required by the nrf52840dk board (Nordic based)
          - fatfs # required for fatfs, used by fs-module
    # File system module
    - name: zephyr-fs-module
      remote: borrelunde
      revision: main
      path: modules/fs-module
```
